## config/boards/shields/corny/Kconfig.shield
```kconfig
config SHIELD_CORNY_LEFT
    def_bool $(shields_list_contains,corny_left)

config SHIELD_CORNY_RIGHT
    def_bool $(shields_list_contains,corny_right)

config SHIELD_CORNY_CENTRAL_DONGLE
    def_bool $(shields_list_contains,corny_central_dongle)
```
